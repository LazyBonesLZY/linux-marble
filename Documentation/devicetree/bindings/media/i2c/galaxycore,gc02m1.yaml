## Documentation/devicetree/bindings/media/i2c/galaxycore,gc02m1.yaml
```yaml
# SPDX-License-Identifier: (GPL-2.0-only OR BSD-2-Clause)
%YAML 1.2
---
$id: http://devicetree.org/schemas/media/i2c/galaxycore,gc02m1.yaml#
$schema: http://devicetree.org/meta-schemas/core.yaml#

title: GalaxyCore GC02M1 2M Pixel MIPI CSI-2 Sensor

maintainers:
  - LazyBonesLZY <lazyboneslzy@users.noreply.github.com>

description:
  The GC02M1 is a 1600x1200 raw Bayer CMOS image sensor with an MIPI CSI-2
  data interface and an I2C control bus. Chip id is read as a 16-bit value
  from register 0xf0 and equals 0x02e0 (distinct from GC02M2 0x02f0).

properties:
  compatible:
    const: galaxycore,gc02m1

  reg:
    maxItems: 1

  clocks:
    maxItems: 1

  dovdd-supply:
    description: Digital I/O voltage supply (typically 1.8 V).

  avdd-supply:
    description: Analog voltage supply (typically 2.8 V).

  reset-gpios:
    description: Active-low GPIO connected to the sensor reset pin.
    maxItems: 1

  port:
    $ref: /schemas/graph.yaml#/$defs/port-base
    additionalProperties: false
    description:
      Output port node, single endpoint describing the CSI-2 transmitter.

    properties:
      endpoint:
        $ref: /schemas/media/video-interfaces.yaml#
        unevaluatedProperties: false

        properties:
          data-lanes:
            items:
              - const: 1

          link-frequencies: true

        required:
          - data-lanes
          - link-frequencies

    required:
      - endpoint

required:
  - compatible
  - reg
  - clocks
  - dovdd-supply
  - avdd-supply
  - reset-gpios
  - port

additionalProperties: false

examples:
  - |
    #include <dt-bindings/clock/qcom,sm8450-camcc.h>
    #include <dt-bindings/gpio/gpio.h>

    i2c {
        #address-cells = <1>;
        #size-cells = <0>;

        camera@37 {
            compatible = "galaxycore,gc02m1";
            reg = <0x37>;

            clocks = <&camcc CAM_CC_MCLK0_CLK>;
            assigned-clocks = <&camcc CAM_CC_MCLK0_CLK>;
            assigned-clock-rates = <19200000>;

            reset-gpios = <&tlmm 128 GPIO_ACTIVE_LOW>;

            dovdd-supply = <&vreg_1p8>;
            avdd-supply = <&vreg_2p8>;

            port {
                endpoint {
                    data-lanes = <1>;
                    link-frequencies = /bits/ 64 <336000000>;
                    remote-endpoint = <&csiphy_ep>;
                };
            };
        };
    };
...
```

## Documentation/devicetree/bindings/media/i2c/samsung,s5k3p9.yaml
```yaml
# SPDX-License-Identifier: (GPL-2.0-only OR BSD-2-Clause)
%YAML 1.2
---
$id: http://devicetree.org/schemas/media/i2c/samsung,s5k3p9.yaml#
$schema: http://devicetree.org/meta-schemas/core.yaml#

title: Samsung S5K3P9 (ISOCELL Slim 3P9) Image Sensor

maintainers:
  - LazyBonesLZY <lazyboneslzy@users.noreply.github.com>

description:
  Samsung S5K3P9 / S5K3P9SP is a 16MP raw Bayer CMOS image sensor with a
  CCI (I2C-compatible) control bus and a MIPI CSI-2 data interface.
  Chip id is read from register 0x0000 and equals 0x3109.

allOf:
  - $ref: /schemas/media/video-interface-devices.yaml#

properties:
  compatible:
    const: samsung,s5k3p9

  reg:
    maxItems: 1

  clocks:
    description: Sensor MCLK clock.
    maxItems: 1

  reset-gpios:
    description: Active-low GPIO connected to the sensor reset pin.
    maxItems: 1

  vio-supply:
    description: Digital I/O voltage supply (typically 1.8 V).

  vana-supply:
    description: Analog voltage supply (typically 2.8 V).

  vdig-supply:
    description: Digital core voltage supply (typically 1.0 V).

  port:
    $ref: /schemas/graph.yaml#/$defs/port-base
    additionalProperties: false

    properties:
      endpoint:
        $ref: /schemas/media/video-interfaces.yaml#
        unevaluatedProperties: false

        properties:
          data-lanes:
            items:
              - const: 1
              - const: 2
              - const: 3
              - const: 4

        required:
          - data-lanes
          - link-frequencies

    required:
      - endpoint

required:
  - compatible
  - reg
  - clocks
  - reset-gpios
  - vio-supply
  - vana-supply
  - vdig-supply
  - port

unevaluatedProperties: false

examples:
  - |
    #include <dt-bindings/clock/qcom,sm8450-camcc.h>
    #include <dt-bindings/gpio/gpio.h>

    i2c {
        #address-cells = <1>;
        #size-cells = <0>;

        camera@10 {
            compatible = "samsung,s5k3p9";
            reg = <0x10>;

            clocks = <&camcc CAM_CC_MCLK5_CLK>;
            assigned-clocks = <&camcc CAM_CC_MCLK5_CLK>;
            assigned-clock-rates = <19200000>;

            reset-gpios = <&tlmm 127 GPIO_ACTIVE_LOW>;

            vio-supply = <&vreg_1p8>;
            vana-supply = <&vreg_2p8>;
            vdig-supply = <&vreg_1p0>;

            port {
                endpoint {
                    data-lanes = <1 2 3 4>;
                    link-frequencies = /bits/ 64 <600000000>;
                    remote-endpoint = <&csiphy_ep>;
                };
            };
        };
    };
...
```

## drivers/input/fingerprint/Kconfig
```kconfig
# SPDX-License-Identifier: GPL-2.0
#
# Fingerprint sensor configuration
#

menuconfig INPUT_FINGERPRINT
	bool "Fingerprint sensors"
	help
	  Say Y here to be able to choose fingerprint sensor drivers.
	  These drivers only provide the platform plumbing (power, reset,
	  IRQ, character device/netlink) expected by the vendor TEE-backed
	  HALs; the actual fingerprint matching happens in the TEE.

	  If unsure, say N.

if INPUT_FINGERPRINT

source "drivers/input/fingerprint/fpc_1540/Kconfig"
source "drivers/input/fingerprint/goodix_3626/Kconfig"
source "drivers/input/fingerprint/xiaomi_fp/Kconfig"

endif
```

## drivers/input/fingerprint/fpc_1540/Kconfig
```kconfig
# SPDX-License-Identifier: GPL-2.0
config FINGERPRINT_FPC_1540
	tristate "FPC 1540 fingerprint sensor platform driver"
	depends on INPUT_FINGERPRINT
	help
	  Platform driver for the FPC 1540 side-mounted fingerprint sensor
	  used on the Xiaomi marble (POCO F5 / Redmi Note 12 Turbo).

	  It controls the sensor supply, reset line and IRQ and exposes the
	  downstream sysfs ABI used by the FPC vendor HAL.  Fingerprint
	  matching itself is performed by the vendor TEE application.

	  To compile this driver as a module, choose M here.  The module will
	  be called fpc1540.
```

## drivers/input/fingerprint/goodix_3626/Kconfig
```kconfig
# SPDX-License-Identifier: GPL-2.0
config FINGERPRINT_GOODIX_3626
	tristate "Goodix 3626 fingerprint sensor platform driver"
	depends on INPUT_FINGERPRINT
	help
	  Platform driver for the Goodix 3626 side-mounted fingerprint
	  sensor used on the Xiaomi marble (POCO F5 / Redmi Note 12 Turbo).

	  It exposes the downstream /dev/goodix_fp character device, the
	  Goodix netlink events and the input device used by the vendor HAL.
	  Fingerprint matching itself is performed by the vendor TEE
	  application.

	  To compile this driver as a module, choose M here.  The module will
	  be called goodix_3626.
```

## drivers/input/fingerprint/xiaomi_fp/Kconfig
```kconfig
# SPDX-License-Identifier: GPL-2.0
config FINGERPRINT_XIAOMI_FP
	tristate "Xiaomi fingerprint hub"
	depends on INPUT_FINGERPRINT
	help
	  Small Xiaomi fingerprint hub driver.  It exposes the "fingerdown"
	  sysfs attribute used by the vendor fingerprint HAL on Xiaomi
	  devices such as marble (POCO F5 / Redmi Note 12 Turbo).

	  To compile this driver as a module, choose M here.  The module will
	  be called xiaomifp.
```
